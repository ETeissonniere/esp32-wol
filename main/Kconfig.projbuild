## main/Kconfig.projbuild
```kconfig
menu "Esp32 WoL Configuration"

    config ESP_WIFI_SSID
        string "WiFi SSID"
        default "myssid"
        help
            SSID (network name) for the program to connect to.

    config ESP_WIFI_PASSWORD
        string "WiFi Password"
        default "mypassword"
        help
            WiFi password (WPA or WPA2) for the program to use.

    config WOL_TARGET_MAC
        string "Target MAC address for WoL"
        default "00:11:22:33:44:55"
        help
            The MAC address of the device to wake, in the standard format
            "AA:BB:CC:DD:EE:FF".
            Example: 00:1A:2B:3C:4D:5E
            
endmenu
```

## sdkconfig.defaults
```kconfig
CONFIG_IDF_TARGET="esp32s3"
CONFIG_LWIP_LOCAL_HOSTNAME="esp32-wol"

CONFIG_ETHERNET_SPI_SUPPORT=y
CONFIG_ETHERNET_SPI_USE_W5500=y
CONFIG_ETHERNET_SPI_AUTOCONFIG_MAC_ADDR0=y
CONFIG_ETHERNET_SPI_CS0_GPIO=14
CONFIG_ETHERNET_SPI_PHY_RST0_GPIO=9
CONFIG_ETHERNET_SPI_INT0_GPIO=10
CONFIG_ETHERNET_SPI_SCLK_GPIO=13
CONFIG_ETHERNET_SPI_MOSI_GPIO=11
CONFIG_ETHERNET_SPI_MISO_GPIO=12
```
